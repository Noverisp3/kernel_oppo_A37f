## drivers/block/zram/Kconfig
```kconfig
config ZRAM
	tristate "Compressed RAM block device support"
	depends on BLOCK && SYSFS && ZSMALLOC
	select LZO_COMPRESS
	select LZO_DECOMPRESS
	default n
	help
	  Creates virtual block devices called /dev/zramX (X = 0, 1, ...).
	  Pages written to these disks are compressed and stored in memory
	  itself. These disks allow very fast I/O and compression provides
	  good amounts of memory savings.

	  It has several use cases, for example: /tmp storage, use as swap
	  disks and maybe many more.

	  See zram.txt for more information.

config ZRAM_CINNAMON_COMPRESS
	bool "Enable Cinnamon algorithm support"
	depends on ZRAM
	help
	  This option enables Cinnamon compression algorithm support.
	  Cinnamon is a frame-based compression optimized for Android workloads
	  with minimal CPU overhead and L1 cache locality. It provides adaptive
	  compression based on I/O pressure from Cinnamon I/O scheduler.

	  Compression algorithm can be changed using `comp_algorithm' device attribute.
```
